## drivers/input/misc/aw8680x/Kconfig
```kconfig
config TOUCH_AW8680X
	tristate "Awinic AW8680X Touchkey"
	depends on I2C
	help
		Say Y here if you have Awinic aw8680x touchkey controller
		chip in your system.

		If unsure, say N.

		To compile this driver as a module, choose M here: the
		module will be called aw8680x.
```

## drivers/input/misc/haptic_hv/Kconfig
```kconfig
#
# Qcom AWINIC_HAPTIC_HV Driver
#

config AWINIC_HAPTIC_HV
	tristate "AWINIC_HAPTIC_HV driver"
	depends on I2C
	help
	  Say Y here if you have Awinic AW869X/AW869XX haptic controller
	  chip in your system.
	  If unsure, say N.
	  To compile this driver as a module, choose M here: the
	  module will be called awinic_haptic_hv.

config CONFIG_AWINIC_8691X_HAPTIC_HV
	tristate "CONFIG_AWINIC_8691X_HAPTIC_HV driver"
	depends on I2C
	help
	  Say Y here if you have Awinic AW8691X haptic controller
	  chip in your system.
	  If unsure, say N.
	  To compile this driver as a module, choose M here: the
	  module will be called awinic_haptic_8691x_hv.
```

## drivers/input/snt8100fsr/Kconfig
```kconfig
#
# SNT8100FSR driver configuration
#

config SENSORS_SNT8100FSR
    tristate "SNT8100FSR Grip Sensor driver"
    depends on INPUT && I2C
    help
      Say Y here to enable
```

## drivers/input/touchscreen/ktz8866/Kconfig
```kconfig
# SPDX-License-Identifier: GPL-2.0-only
#
# ktz8866 backlight driver configuration
#

config KTZ8866_BACKLIGHT_BKL
	tristate "ktz8866 LCD Backlight driver for bkl"
	depends on I2C
	help
	  This option enables support for the LCD backlight using
	  bkl chip.
```
